## sdkconfig.defaults
```kconfig
# Bluetooth
CONFIG_BT_ENABLED=y

# Improves nunchuk read speeds
CONFIG_FREERTOS_HZ=1000
CONFIG_ESP32_DEFAULT_CPU_FREQ_240=y
CONFIG_ESP32_DEFAULT_CPU_FREQ_MHZ=240

# increase factory app size
CONFIG_PARTITION_TABLE_CUSTOM=y
CONFIG_PARTITION_TABLE_CUSTOM_FILENAME="partitions.csv"
CONFIG_PARTITION_TABLE_FILENAME="partitions.csv"
```

## test/sdkconfig.defaults
```kconfig
CONFIG_ESP_TASK_WDT=n

# From main project
# Bluetooth
CONFIG_BT_ENABLED=y

# Improves nunchuk read speeds
CONFIG_FREERTOS_HZ=1000
CONFIG_ESP32_DEFAULT_CPU_FREQ_240=y
CONFIG_ESP32_DEFAULT_CPU_FREQ_MHZ=240
```
